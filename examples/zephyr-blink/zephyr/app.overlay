/ {
     aliases {
             led3 = &myled0;
     };
     leds {
             compatible = "gpio-leds";
             myled0: led_0 {
                gpios = <&gpioa 7 GPIO_ACTIVE_LOW>;
                label = "LED3";
             };
     };
};